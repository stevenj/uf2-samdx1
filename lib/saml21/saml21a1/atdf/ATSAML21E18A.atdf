# ATSAML21E18A device description
Architecture: CORTEX-M0PLUS; Family: SAML; Series: SAML21
Parameters: LITTLE_ENDIAN=1, NUM_IRQ=29, __CM0PLUS_REV=0x0001, __MPU_PRESENT=0, __NVIC_PRIO_BITS=2, __VTOR_PRESENT=1, __Vendor_SysTickConfig=0, __ARCH_ARM=1, __ARCH_ARM_CORTEX_M=1, __DEVICE_IS_SAM=1
Programming and debug interfaces: SWD
Registers are 32-bit, read-write, reset 0x0 unless marked. A register's access mark holds for its fields unless they carry their own. Offsets are from the block's base; lines under a group give offsets from that group; [hi:lo] are bit positions; {n}, {i} and the like mark numbered series; 'fields as' and 'values as' point back to an identical list; <NAME> marks a mode.

## Ordering variants
SAML21E18A-AU: TQFP32, pinout SAML21E, up to 48 MHz, -40 to 85 C, 1.62 to 3.63 V

## Memory
base space: start 0 size 0x100000000, little endian
  0x00000000 FLASH size 0x40000 flash, rw, executable, page 64
  0x00800000 CAL size 0x8 fuses, ro
  0x00802000 LOCKBIT size 0x4 fuses, ro
  0x00804000 AUX0 size 0x100 user_page, rw, page 64
  0x00806000 AUX1 size 0x100 fuses, ro, page 64
  0x00400000 RWW size 0x2000 flash, rw, executable, page 64
  0x20000000 HSRAM size 0x8000 ram, rw, executable
  0x30000000 LPRAM size 0x2000 ram, rw, executable
  0x40000000 HPB0 size 0x4000 io, rw
  0x41000000 HPB1 size 0x10000 io, rw
  0x42000000 HPB2 size 0x8000 io, rw
  0x43000000 HPB3 size 0x2000 io, rw
  0x44000000 HPB4 size 0x1000 io, rw
  0xE0000000 PPB size 0x100000 io, rw
  0xE000E000 SCS size 0x00001000 io, rw
  0x40000000 PERIPHERALS size 0x20000000 io, rw
fuses space: start 0x00000000 size 0x10000, little endian

## Peripheral instances (address, pins/pin function, parameters)
AC at 0x43001000
  pins: AIN0 PA04/B_AC; AIN1 PA05/B_AC; AIN2 PA06/B_AC; AIN3 PA07/B_AC; CMP0 PA18/H; CMP1 PA19/H
  parameters: COMPCTRL_MUXNEG_OPAMP=7, GCLK_ID=31, NUM_CMP=2, PAIRS=1, INSTANCE_ID=100
ADC at 0x43000C00
  pins: AIN0 PA02/B_ADC; AIN1 PA03/B_ADC; AIN4 PA04/B_ADC; AIN5 PA05/B_ADC; AIN6 PA06/B_ADC; AIN7 PA07/B_ADC; AIN16 PA08/B_ADC; AIN17 PA09/B_ADC; AIN18 PA10/B_ADC; AIN19 PA11/B_ADC; VREFP PA04/B_ANAREF
  parameters: DMAC_ID_RESRDY=37, EXTCHANNEL_MSB=19, GCLK_ID=30, RESULT_BITS=16, RESULT_MSB=15, INSTANCE_ID=99
AES at 0x42003400
  parameters: DMAC_ID_RD=45, DMAC_ID_WR=44, INSTANCE_ID=77
CCL at 0x43001C00
  pins: IN0 PA04/I or PA16/I; IN1 PA05/I or PA17/I; IN2 PA06/I or PA18/I; IN3 PA08/I or PA30/I; IN4 PA09/I; IN5 PA10/I; IN6 PA22/I; IN7 PA23/I; IN8 PA24/I; OUT0 PA07/I or PA19/I; OUT1 PA11/I or PA31/I; OUT2 PA25/I
  parameters: GCLK_ID=34, IO_NUM=12, LUT_NUM=4, SEQ_NUM=2, INSTANCE_ID=103
DAC at 0x42003000
  pins: VOUT0 PA02/B_DAC; VOUT1 PA05/B_DAC; VREFP PA03/B_ANAREF
  parameters: DAC_NUM=2, DATA_SIZE=12, GCLK_ID=32, INSTANCE_ID=76
DMAC at 0x44000400
  parameters: CH_BITS=4, CH_NUM=16, EVIN_NUM=8, EVOUT_NUM=8, LVL_BITS=2, LVL_NUM=4, QOSCTRL_D_RESETVALUE=2, QOSCTRL_F_RESETVALUE=2, QOSCTRL_WRB_RESETVALUE=2, TRIG_BITS=6, TRIG_NUM=46, INSTANCE_ID=129
DSU at 0x41002000
  parameters: INSTANCE_ID=33
EIC at 0x40002400
  pins: EXTINT0 PA16/A or PA00/A; EXTINT1 PA17/A or PA01/A; EXTINT2 PA02/A or PA18/A; EXTINT3 PA03/A or PA19/A; EXTINT4 PA04/A; EXTINT5 PA05/A; EXTINT6 PA06/A or PA22/A; EXTINT7 PA07/A or PA23/A; EXTINT9 PA09/A; EXTINT10 PA10/A or PA30/A; EXTINT11 PA11/A or PA31/A; EXTINT12 PA24/A; EXTINT13 PA25/A; EXTINT14 PA14/A; EXTINT15 PA27/A or PA15/A; NMI PA08/A
  parameters: GCLK_ID=3, NUMBER_OF_CONFIG_REGS=2, NUMBER_OF_INTERRUPTS=16, INSTANCE_ID=9
EVSYS at 0x43000000
  parameters: CHANNELS=12, CHANNELS_BITS=4, CHANNELS_MSB=11, EXTEVT_NUM=0, GENERATORS=83, GENERATORS_BITS=7, USERS=45, USERS_BITS=6, INSTANCE_ID=96
GCLK at 0x40001800
  pins: IO0 PA14/H or PA27/H or PA30/H; IO1 PA15/H; IO2 PA16/H; IO3 PA17/H; IO4 PA10/H; IO5 PA11/H; IO6 PA22/H; IO7 PA23/H
  parameters: GENDIV_BITS=16, GEN_NUM=9, GEN_NUM_MSB=8, GEN_SOURCE_NUM_MSB=8, NUM=36, SOURCE_DFLL48M=7, SOURCE_DPLL96M=8, SOURCE_GCLKGEN1=2, SOURCE_GCLKIN=1, SOURCE_NUM=9, SOURCE_OSCULP32K=3, SOURCE_OSC16M=6, SOURCE_OSC32K=4, SOURCE_XOSC=0, SOURCE_XOSC32K=5, INSTANCE_ID=6
MCLK at 0x40000400
  parameters: CTRLA_MCSEL_GCLK=1, CTRLA_MCSEL_OSC8M=0, MCLK_CLK_APB_NUM=5, SYSTEM_CLOCK=4000000, INSTANCE_ID=1
  clocks: AHB HPB0 bit 0, HPB1 bit 1, HPB2 bit 2, HPB3 bit 3, HPB4 bit 4, DSU bit 5, NVMCTRL bit 8, HSRAM bit 9, LPRAM bit 10, DMAC bit 11, USB bit 12, PAC bit 14, NVMCTRL_PICACHU bit 15, L2HBRIDGES_H bit 16, H2LBRIDGES_H bit 17, HSRAM_AHBSETUPKEEPER bit 18, HSRAM_HMATRIXLP2HMCRAMCHSBRIDGE bit 19
MTB at 0x41006000
  parameters: INSTANCE_ID=35
NVMCTRL at 0x41004000
  pins: MARGIN VMARGIN
  parameters: FACTORY_WORD_IMPLEMENTED_MASK=0XC0000007FFFFFFFF, GCLK_ID=35, PMSB=3, PSZ_BITS=6, USER_PAGE_OFFSET=0x00800000, USER_WORD_IMPLEMENTED_MASK=0XC01FFFFFFFFFFFFF, RWWEE_PAGES=128, RWW_EEPROM_ADDR=0x00400000, RWW_EEPROM_SIZE=8192, FLASH_SIZE=262144, PAGE_SIZE=64, PAGES=4096, PAGES_PR_REGION=256, PSM_0_FRMFW_FWS_1_MAX_FREQ=12000000, PSM_0_FRMLP_FWS_0_MAX_FREQ=18000000, PSM_0_FRMLP_FWS_1_MAX_FREQ=36000000, PSM_0_FRMHS_FWS_0_MAX_FREQ=25000000, PSM_0_FRMHS_FWS_1_MAX_FREQ=50000000, PSM_1_FRMFW_FWS_1_MAX_FREQ=12000000, PSM_1_FRMLP_FWS_0_MAX_FREQ=8000000, PSM_1_FRMLP_FWS_1_MAX_FREQ=12000000, INSTANCE_ID=34
FUSES at OTP5_FUSES 0x00806020 in fuses, TEMP_LOG_FUSES 0x00806030 in fuses, USER_FUSES 0x00804000 in fuses
OPAMP at 0x43001800
  pins: OANEG0 PA02/B_OPAMP; OAOUT0 PA07/B_OPAMP; OAOUT2 PA04/B_OPAMP; OAPOS0 PA06/B_OPAMP; OAPOS2 PA05/B_OPAMP
  parameters: INSTANCE_ID=102
OSCCTRL at 0x40000C00
  pins: XIN PA14/XIN; XOUT PA15/XOUT
  parameters: DFLL48M_COARSE_MSB=5, DFLL48M_FINE_MSB=9, GCLK_ID_DFLL48=0, GCLK_ID_FDPLL=1, GCLK_ID_FDPLL32K=2, DFLL48M_VERSION=0x310, FDPLL_VERSION=0x200, OSC16M_VERSION=0x100, XOSC_VERSION=0x120, INSTANCE_ID=3
OSC32KCTRL at 0x40001000
  pins: XIN32 PA00/XIN32; XOUT32 PA01/XOUT32
  parameters: OSC32K_COARSE_CALIB_MSB=6, INSTANCE_ID=4
PAC at 0x44000000
  parameters: HPB_NUM=5, INTFLAG_NUM=6, INSTANCE_ID=128
PM at 0x40000000
  pins: RESET_N RESET_N
  parameters: PD_NUM=3, INSTANCE_ID=0
PORT at 0x40002800, PORT_IOBUS 0x60000000
  pins: P{n} PA{n:02} (n=0..11); P14 PA14; P15 PA15; P16 PA16; P17 PA17; P18 PA18; P19 PA19; P22 PA22; P23 PA23; P24 PA24; P25 PA25; P27 PA27; P30 PA30; P31 PA31
  parameters: BITS=84, DRVSTR=1, EV_NUM=4, GROUPS=1, ODRAIN=0, SLEWLIM=0, INSTANCE_ID=10
PTC at 0x43001400
  pins: X0 PA08/B_PTCX; X1 PA09/B_PTCX; X2 PA10/B_PTCX; X3 PA11/B_PTCX; X4 PA16/B_PTCX; X5 PA17/B_PTCX; X6 PA18/B_PTCX; X7 PA19/B_PTCX; X10 PA22/B_PTCX; X11 PA23/B_PTCX; Y{n} PA{n+2:02}/B_PTCY (n=0..9)
  parameters: GCLK_ID=33, INSTANCE_ID=101
RSTC at 0x40000800
  pins: EXTWAKE{n} PA{n:02}/A_EXTWAKE (n=0..11); EXTWAKE14 PA14/A_EXTWAKE; EXTWAKE15 PA15/A_EXTWAKE
  parameters: NUMBER_OF_EXTWAKE=16, INSTANCE_ID=2
RTC at 0x40002000
  parameters: ALARM_NUM=1, COMP16_NUM=2, COMP32_NUM=1, GPR_NUM=4, PER_NUM=8, INSTANCE_ID=8
SERCOM0 at 0x42000000 (SERCOM)
  pins: PAD0 PA04/D or PA08/C; PAD1 PA05/D or PA09/C; PAD2 PA06/D or PA10/C; PAD3 PA07/D or PA11/C
  parameters: DMAC_ID_RX=1, DMAC_ID_TX=2, GCLK_ID_CORE=18, GCLK_ID_SLOW=17, INT_MSB=6, PMSB=3, INSTANCE_ID=64
SERCOM1 at 0x42000400 (SERCOM)
  pins: PAD0 PA16/C or PA00/D; PAD1 PA17/C or PA01/D; PAD2 PA30/D or PA18/C; PAD3 PA31/D or PA19/C
  parameters: DMAC_ID_RX=3, DMAC_ID_TX=4, GCLK_ID_CORE=19, GCLK_ID_SLOW=17, INT_MSB=6, PMSB=3, INSTANCE_ID=65
SERCOM2 at 0x42000800 (SERCOM)
  pins: PAD0 PA08/D; PAD1 PA09/D; PAD2 PA10/D or PA14/C; PAD3 PA11/D or PA15/C
  parameters: DMAC_ID_RX=5, DMAC_ID_TX=6, GCLK_ID_CORE=20, GCLK_ID_SLOW=17, INT_MSB=6, PMSB=3, INSTANCE_ID=66
SERCOM3 at 0x42000C00 (SERCOM)
  pins: PAD0 PA16/D or PA22/C or PA27/F_RF233; PAD1 PA17/D or PA23/C; PAD2 PA18/D or PA24/C; PAD3 PA19/D or PA25/C
  parameters: DMAC_ID_RX=7, DMAC_ID_TX=8, GCLK_ID_CORE=21, GCLK_ID_SLOW=17, INT_MSB=6, PMSB=3, INSTANCE_ID=67
SUPC at 0x40001400
  parameters: BOD12_CALIB_MSB=5, BOD33_CALIB_MSB=5, SUPC_OUT_NUM_MSB=1, INSTANCE_ID=5
TC0 at 0x42002000 (TC)
  pins: WO0 PA22/E; WO1 PA23/E
  parameters: CC_NUM=2, DMAC_ID_OVF=22, EXT=0, GCLK_ID=27, MASTER=1, OW_NUM=2, INSTANCE_ID=72
TC1 at 0x42002400 (TC)
  pins: WO0 PA24/E; WO1 PA25/E
  parameters: CC_NUM=2, DMAC_ID_OVF=25, EXT=0, GCLK_ID=27, MASTER=0, OW_NUM=2, INSTANCE_ID=73
TC4 at 0x43000800 (TC)
  pins: WO0 PA18/E or PA14/E; WO1 PA19/E or PA15/E
  parameters: CC_NUM=2, DMAC_ID_OVF=34, EXT=0, GCLK_ID=29, MASTER=0, OW_NUM=2, INSTANCE_ID=98
TCC0 at 0x42001400 (TCC)
  pins: WO0 PA04/E or PA08/E or PA16/F_RF233; WO1 PA05/E or PA09/E or PA17/F_RF233; WO2 PA10/F or PA18/F; WO3 PA11/F or PA19/F; WO4 PA22/F or PA14/F; WO5 PA15/F or PA23/F; WO6 PA16/F; WO7 PA17/F
  parameters: CC_NUM=4, DITHERING=1, DMAC_ID_OVF=11, DTI=1, EXT=31, GCLK_ID=25, OTMX=1, OW_NUM=8, PG=1, SIZE=24, SWAP=1, TYPE=1, INSTANCE_ID=69
TCC1 at 0x42001800 (TCC)
  pins: WO0 PA06/E or PA10/E or PA30/E; WO1 PA07/E or PA11/E or PA31/E; WO2 PA08/F or PA24/F; WO3 PA09/F or PA25/F
  parameters: CC_NUM=2, DITHERING=1, DMAC_ID_OVF=16, DTI=0, EXT=24, GCLK_ID=25, OTMX=0, OW_NUM=4, PG=1, SIZE=24, SWAP=0, TYPE=2, INSTANCE_ID=70
TCC2 at 0x42001C00 (TCC)
  pins: WO0 PA16/E or PA00/E; WO1 PA17/E or PA01/E
  parameters: CC_NUM=2, DITHERING=0, DMAC_ID_OVF=19, DTI=0, EXT=0, GCLK_ID=26, OTMX=0, OW_NUM=2, PG=0, SIZE=16, SWAP=0, TYPE=0, INSTANCE_ID=71
TRNG at 0x42003800
  parameters: INSTANCE_ID=78
USB at 0x41000000
  pins: DM PA24/G; DP PA25/G; SOF_1KHZ PA23/G
  parameters: EPT_NBR=8, EPT_NUM=8, GCLK_ID=4, PIPE_NUM=8, INSTANCE_ID=32
WDT at 0x40001C00
  parameters: INSTANCE_ID=7
NVIC at 0xE000E100
  parameters: NUM_IRQ=29, __NVIC_PRIO_BITS=2
SysTick at 0xE000E010
SystemControl at 0xE000E000
  parameters: __VTOR_PRESENT=1

## Interrupts
-14 NonMaskableInt — Non Maskable Interrupt
-13 HardFault — Cortex-M0+ Hard Fault Interrupt
-5 SVCall — Cortex-M0+ SV Call Interrupt
-2 PendSV — Cortex-M0+ Pend SV Interrupt
-1 SysTick — Cortex-M0+ System Tick Interrupt
0 SYSTEM (MCLK OSCCTRL OSC32KCTRL PAC PM SUPC)
1 WDT
2 RTC
3 EIC
4 NVMCTRL
5 DMAC
6 USB
7 EVSYS
8 SERCOM0
9 SERCOM1
10 SERCOM2
11 SERCOM3
14 TCC0
15 TCC1
16 TCC2
17 TC0
18 TC1
21 TC4
22 ADC
23 AC
24 DAC
25 PTC
26 AES
27 TRNG

## Properties
SIGNATURES: DSU_DID=0x1081000A

## Pinouts (pin number, pad)
SAML21E: 1 PA00, 2 PA01, 3 PA02, 4 PA03, 5 PA04, 6 PA05, 7 PA06, 8 PA07, 9 VDDANA, 10 GNDIO, 11 PA08, 12 PA09, 13 PA10, 14 PA11, 15 PA14, 16 PA15, 17 PA16, 18 PA17, 19 PA18, 20 PA19, 21 PA22, 22 PA23, 23 PA24, 24 PA25, 25 PA27, 26 RESET_N, 27 VDDCORE, 28 GNDIO, 29 VSW, 30 VDDIN, 31 PA30, 32 PA31

## Notices in the file
Copyright (c) 2017 Microchip Technology Inc.
SPDX-License-Identifier: Apache-2.0
Licensed under the Apache License, Version 2.0 (the "License");
you may not use this file except in compliance with the License.
You may obtain a copy of the License at
http://www.apache.org/licenses/LICENSE-2.0
Unless required by applicable law or agreed to in writing, software
distributed under the License is distributed on an "AS IS" BASIS,
WITHOUT WARRANTIES OR CONDITIONS OF ANY KIND, either express or implied.
See the License for the specific language governing permissions and
limitations under the License.
